#include <dt-bindings/zmk/behaviors.h>

/ {
	behaviors {
#if ZMK_BEHAVIOR_OMIT(BAT_PRINT)
		/omit-if-no-ref/
#endif
		bat_print: bat_print {
			compatible = "zmk,behavior-bat-print";
			#binding-cells = <0>;
			display-name = "Battery Print";
		};
	};
};
