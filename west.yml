## west.yml
```yaml
manifest:
  remotes:
    - name: remote-name
      url-base: https://github.com/eintim
  projects:
    # Together with the above defined remote, this refers to a module located at
    # https://github.com/remote-name/repository-name
    - name: repository-name
      remote: zmk-behavior-battery-typer
      # This points to a west manifest file in the remote module for further imports
      import: west.yml
```
