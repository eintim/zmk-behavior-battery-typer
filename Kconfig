## Kconfig
```kconfig
config ZMK_BEHAVIOR_BAT_PRINT
	bool "Bat print behavior: type battery percentage as digits"
	default y
	depends on DT_HAS_ZMK_BEHAVIOR_BAT_PRINT_ENABLED && ZMK_BATTERY_REPORTING
	help
	  When enabled, the &bat_print behavior types the current keyboard
	  battery percentage (0-100) as digits into the focused application.
```

## dts/bindings/zmk,behavior-bat-print.yaml
```yaml
description: Behavior that types the current battery percentage

compatible: "zmk,behavior-bat-print"

include: zero_param.yaml

properties:
  tap-ms:
    type: int
    default: 30
    description: Time in milliseconds each digit key is held down
  wait-ms:
    type: int
    default: 15
    description: Time in milliseconds to wait after releasing a key before the next one
```
